GPIO_PORTF_DATA  	EQU 0x400253FC
GPIO_PORTF_DIR   	EQU 0x40025400
GPIO_PORTF_IM		EQU 0x40025410
GPIO_PORTF_RIS		EQU 0x40025414
GPIO_PORTF_MIS		EQU 0x40025418
GPIO_PORTF_ICR		EQU 0x4002541C
GPIO_PORTF_AFSEL 	EQU 0x40025420
GPIO_PORTF_PUR   	EQU 0x40025510
GPIO_PORTF_DEN   	EQU 0x4002551C
GPIO_PORTF_LOCK  	EQU 0x40025520
GPIO_PORTF_CR   	EQU 0x40025524
GPIO_PORTF_AMSEL 	EQU 0x40025528
GPIO_PORTF_PCTL  	EQU 0x4002552C
GPIO_PORTF_PDR 		EQU 0x40025514
	

;LABEL		DIRECTIVE		VALUE		COMMENT
			AREA			portfhandler, CODE, READONLY
			THUMB
			EXPORT		PortF_Handler
				
PortF_Handler	PROC
				PUSH{R0,R1,LR}
				;Determine which button caused interrupt
				LDR R1,=GPIO_PORTF_RIS
				LDR R0,[R1]
				ANDS R0,#0x01		;If R0 remains zero then PF4 caused the interrupt, i.e SW1
				BEQ	switch1
				B switch2			;otherwise bit0 of RIS is 1, so PF0 caused the interrupt.
switch1			LDR R1,=GPIO_PORTF_DATA
				LDR R0,[R1]
				ORR R0,R0,#0x02
				STR R0,[R1]
				B end_loop
switch2 		LDR R1,=GPIO_PORTF_DATA
				LDR R0,[R1]
				ORR R0,R0,#0x04
				STR R0,[R1]
end_loop		LDR R1,=GPIO_PORTF_ICR
				LDR R0,[R1]
				ORR R0,R0,#0x03
				STR R0,[R1]
				ADD R3,#1
				POP{R0,R1,LR}	
				BX	LR
		ENDP
	END